## subsys/rtio/Kconfig.async_shim
```kconfig
# Copyright (c) 2024 Croxel Inc.
# SPDX-License-Identifier: Apache-2.0

config RTIO_ASYNC_SHIM
	bool "RTIO Asynchronous Shim layer to process Sync Requests"
	select SCHED_DEADLINE
	select RTIO_CONSUME_SEM
	help
	  Enable RTIO shim layer to allow submitting synchronous requests
	  in an asynchronous non-blocking fashion.

if RTIO_ASYNC_SHIM

config RTIO_ASYNC_SHIM_WQ_PRIO_MED
	int "Medium Thread priority of RTIO Asynchronous Shim (P4WQ's)"
	default MAIN_THREAD_PRIORITY

config RTIO_ASYNC_SHIM_WQ_STACK_SIZE
	int "Thread stack-size of RTIO Asynchronous Shim (P4WQ's)"
	default 2048

config RTIO_ASYNC_SHIM_WQ_THREADS_POOL
	int "Number of threads to use for processing asynchronous work-items"
	default 1

config RTIO_ASYNC_SHIM_WQ_POOL_ITEMS
	int "Pool of work items to work with the RTIO Asynchronous Shim"
	default 4
	help
	  Configure the Pool of work items appropriately to your
	  application, the more asynchronous requests you expect
	  to issue, the bigger this pool should be

endif # RTIO_ASYNC_SHIM
```

## tests/subsys/rtio/async_shim/testcase.yaml
```yaml
tests:
  rtio.async_shim:
    tags: rtio
    integration_platforms:
      - native_sim
```
